## config/west.yml
```yaml
manifest:
  remotes:
    - name: zmkfirmware
      url-base: https://github.com/zmkfirmware
    - name: kevinpastor
      url-base: https://github.com/kevinpastor
    - name: m165437
      url-base: https://github.com/M165437
    - name: 0x1010-dev
      url-base: https://github.com/0x1010-dev
  projects:
    - name: zmk
      remote: zmkfirmware
      revision: main
      import: app/west.yml
    - name: nice-view-elemental
      remote: kevinpastor
      revision: main
    - name: nice-view-gem
      remote: m165437
      revision: main
    - name: nice-view-life
      remote: 0x1010-dev
      revision: main
  self:
    path: config
```
